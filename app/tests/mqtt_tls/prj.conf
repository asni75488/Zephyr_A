## CMakeLists.txt
```
# SPDX-License-Identifier: Apache-2.0
#
# Zephyr_A - native_sim end-to-end test of the cloud path against a real
# Mosquitto broker on the host (Native Simulator offloaded sockets):
#   app_logic -> sparkplug (nanopb) -> mqtt_client (TLS) -> Mosquitto
#   timesync (SNTP from a local test server) -> TLS certificate date check
# Run with run.sh (it creates the test PKI, starts SNTP and the broker).
#
# The TLS/MQTT Kconfig block is taken from app/prj.conf (between the
# ">>> mqtt-tls" and "<<< mqtt-tls" markers), so the test always uses exactly
# the firmware's TLS configuration.

cmake_minimum_required(VERSION 3.20.0)

get_filename_component(ZEPHYR_A_APP ${CMAKE_CURRENT_LIST_DIR}/../.. ABSOLUTE)

file(READ ${ZEPHYR_A_APP}/prj.conf app_prj)
string(FIND "${app_prj}" "# >>> mqtt-tls" tls_begin)
string(FIND "${app_prj}" "# <<< mqtt-tls" tls_end)
if(tls_begin LESS 0 OR tls_end LESS 0)
  message(FATAL_ERROR "mqtt-tls markers not found in app/prj.conf")
endif()
math(EXPR tls_len "${tls_end} - ${tls_begin}")
string(SUBSTRING "${app_prj}" ${tls_begin} ${tls_len} tls_block)
set(tls_conf ${CMAKE_CURRENT_BINARY_DIR}/app-mqtt-tls.conf)
file(WRITE ${tls_conf} "${tls_block}")
list(PREPEND EXTRA_CONF_FILE ${tls_conf})

if(NOT DEFINED TEST_CA_DER)
  message(FATAL_ERROR "Pass -DTEST_CA_DER=<root.der>[;...] (run.sh does this)")
endif()

find_package(Zephyr REQUIRED HINTS $ENV{ZEPHYR_BASE})
project(zephyr_a_mqtt_tls_test LANGUAGES C)

target_sources(app PRIVATE
    src/main.c
    src/stubs.c
    ${ZEPHYR_A_APP}/src/mqtt_client.c
    ${ZEPHYR_A_APP}/src/tls_ca.c
    ${ZEPHYR_A_APP}/src/sparkplug.c
    ${ZEPHYR_A_APP}/src/app_logic.c
    ${ZEPHYR_A_APP}/src/timesync.c
    ${ZEPHYR_A_APP}/src/security.c
    ${ZEPHYR_A_APP}/src/power.c
    ${ZEPHYR_A_APP}/src/health.c
    ${ZEPHYR_A_APP}/src/uplink.c
    ${ZEPHYR_A_APP}/src/proto/sparkplug_b.pb.c
)
target_include_directories(app PRIVATE ${ZEPHYR_A_APP}/src ${ZEPHYR_A_APP}/common)
zephyr_include_directories(${ZEPHYR_A_APP}/config)

include(${ZEPHYR_A_APP}/cmake/ca_certs.cmake)
zephyr_a_add_ca_certs(app ${TEST_CA_DER})

# mTLS build (run.sh scenario 14): -DCONFIG_APP_MQTT_MTLS=y + file paths
if(CONFIG_APP_MQTT_MTLS)
  include(${ZEPHYR_A_APP}/cmake/client_cert.cmake)
  zephyr_a_add_client_cert(app ${CONFIG_APP_MQTT_CLIENT_CERT_FILE}
                               ${CONFIG_APP_MQTT_CLIENT_KEY_FILE})
endif()
```

## Kconfig
```
# Zephyr_A - test Kconfig: the application's own symbols (app/Kconfig,
# which also sources Kconfig.zephyr). Test options are command line
# arguments of zephyr.exe (-run_s, -link_loss_at), see src/main.c.
# SPDX-License-Identifier: Apache-2.0

rsource "../../Kconfig"
```

## prj.conf
```kconfig
# Zephyr_A - native_sim MQTT/TLS test (TLS block appended from app/prj.conf)
CONFIG_STD_C17=y
CONFIG_LOG=y
CONFIG_LOG_MODE_IMMEDIATE=y
CONFIG_APP_LOG_LEVEL_INF=y
CONFIG_NET_LOG=y
CONFIG_INIT_STACKS=y
CONFIG_THREAD_STACK_INFO=y
CONFIG_HEAP_MEM_POOL_SIZE=4096
CONFIG_POLL=y
CONFIG_EVENTS=y

# Host sockets instead of PPP (Native Simulator offloaded sockets)
CONFIG_NETWORKING=y
CONFIG_NET_SOCKETS=y
CONFIG_NET_SOCKETS_OFFLOAD=y
CONFIG_NET_DRIVERS=y
CONFIG_NET_NATIVE_OFFLOADED_SOCKETS=y
CONFIG_ETH_NATIVE_TAP=n
CONFIG_NET_MGMT=y
CONFIG_NET_MGMT_EVENT=y
CONFIG_NET_MGMT_EVENT_INFO=y
CONFIG_DNS_RESOLVER=n

# Mbed TLS heap peak measurement (mbedtls_memory_buffer_alloc_max_get)
CONFIG_MBEDTLS_MEMORY_DEBUG=y

# Same as app/prj.conf (time sync, Sparkplug B, reboot command)
CONFIG_SNTP=y
CONFIG_NANOPB=y
CONFIG_REBOOT=y
# Local SNTP test server started by run.sh
CONFIG_APP_TIMESYNC_SERVER1="127.0.0.1:1123"
CONFIG_APP_TIMESYNC_SERVER2=""
CONFIG_APP_TIMESYNC_TIMEOUT_MS=2000

# Faster test cycle
CONFIG_APP_MQTT_BACKOFF_MIN_S=2
CONFIG_APP_MQTT_BACKOFF_MAX_S=8
CONFIG_APP_MQTT_KEEPALIVE_S=60
CONFIG_APP_SPARKPLUG_STATUS_INTERVAL_S=6
CONFIG_APP_BATCH_SIZE=3
# Reboot-loop protection: short limit so the test can show both cases
CONFIG_APP_SPARKPLUG_REBOOT_MIN_UPTIME_S=5
# Test-only credential for the local test broker started by run.sh
CONFIG_APP_MQTT_PASSWORD="test-password-123"
CONFIG_LOG_BACKEND_SHOW_COLOR=n
```

## prj-interval.conf
```kconfig
# Zephyr_A - native_sim test: interval uplink (part 9), added by run.sh to
# the second build. Short times so one test run shows several uplinks.
CONFIG_APP_UPLINK_INTERVAL=y
CONFIG_APP_UPLINK_INTERVAL_S=60
CONFIG_APP_UPLINK_LINGER_S=2
CONFIG_APP_UPLINK_TIMEOUT_S=20
CONFIG_APP_SPARKPLUG_BATCH_QUEUE_LEN=8
```

## src/main.c
```c
/*
 * Zephyr_A - native_sim end-to-end test driver.
 *
 * Plays the role of the network and sensor threads around the real
 * app_logic, sparkplug, mqtt_client, tls_ca and timesync modules:
 *   1. SNTP sync (like network.c before NETWORK_EVT_UP), exit 3 if it fails
 *   2. NETWORK_EVT_UP -> mqtt connects -> sparkplug sends NBIRTH + DBIRTH
 *   3. one measurement per second into app_logic (batch size 3 -> DDATA),
 *      measurement 4 is BAD (-> is_null), optional link loss
 *   4. prints the counters and the Mbed TLS heap peak; run.sh checks the
 *      broker side with spb.py
 *
 * Interval build (prj-interval.conf, part 9): the uplink thread requests the
 * network itself (stubs.c emulates the modem); main only feeds measurements.
 *
 * Options (zephyr.exe): -run_s=<s> -link_loss_at=<s>
 *
 * SPDX-License-Identifier: Apache-2.0
 */

#include <stdlib.h>

#include <zephyr/kernel.h>
#include <zephyr/logging/log.h>
#include <zephyr/net/net_event.h>
#include <zephyr/net/net_if.h>
#include <zephyr/net/net_mgmt.h>
#include <mbedtls/memory_buffer_alloc.h>

#include "app_logic.h"
#include "mqtt_client.h"
#include "network.h"
#include "health.h"
#include "power.h"
#include "security.h"
#include "sparkplug.h"
#include "timesync.h"
#include "uplink.h"

#include "cmdline.h" /* native_sim command line options */
#include "posix_native_task.h"

LOG_MODULE_REGISTER(test_main, LOG_LEVEL_INF);

static uint32_t run_s = 20;
static uint32_t link_loss_at_s;

static void add_test_options(void)
{
	static struct args_struct_t opts[] = {
		{.option = "run_s", .name = "s", .type = 'u', .dest = (void *)&run_s,
		 .descript = "Print the result and exit after s seconds (default 20)"},
		{.option = "link_loss_at", .name = "s", .type = 'u', .dest = (void *)&link_loss_at_s,
		 .descript = "Simulate NET_EVENT_L4_DISCONNECTED after s seconds (0 = never)"},
		ARG_TABLE_ENDMARKER};

	native_add_command_line_opts(opts);
}
NATIVE_TASK(add_test_options, PRE_BOOT_1, 10);

static void submit_measurement(uint32_t n)
{
	struct measurement m = {
		.uptime_ms = k_uptime_get(),
		.timestamp_ms = timesync_now_ms(),
		.seq = n,
		.count = 1,
	};

	m.values[0].channel = APP_CHANNEL_DIE_TEMP;
	if (n == 4U) {
		m.values[0].quality = QUALITY_BAD; /* -> Sparkplug is_null */
		m.quality = QUALITY_BAD;
	} else {
		m.values[0].value_milli = 21000 + (int32_t)n * 125; /* 21.000, 21.125 ... */
		m.values[0].quality = QUALITY_GOOD;
	}
	(void)app_logic_submit_measurement(&m, K_NO_WAIT);
}

int main(void)
{
	struct app_mqtt_stats st;
	size_t heap_max = 0;
	size_t blocks = 0;
	int ret;

	(void)app_power_init();
	(void)health_init(); /* task watchdog: no false alarms in any scenario */
	(void)app_security_init();
	(void)timesync_init();
	(void)app_logic_init();
	(void)app_logic_start();
	(void)sparkplug_init();
	(void)sparkplug_start();
	ret = app_mqtt_init();
	if (ret == 0) {
		ret = app_mqtt_start();
	}
	if (ret != 0) {
		LOG_ERR("TEST: start failed (%d)", ret);
		exit(2);
	}

	/* Like network.c: no NETWORK_EVT_UP without valid UTC time */
	ret = timesync_sync(CONFIG_APP_TIMESYNC_TIMEOUT_MS);
	if (ret != 0) {
		LOG_ERR("TEST: no time (%d) - network stays down", ret);
		k_sleep(K_SECONDS(1));
		exit(3);
	}
	if (uplink_init() == 0) {
		(void)uplink_start(); /* interval mode: uplink requests the network */
	} else {
		k_event_post(network_events(), NETWORK_EVT_UP);
	}

	for (uint32_t s = 1; s <= run_s; s++) {
		k_sleep(K_SECONDS(1));
		submit_measurement(s);
		if (s == link_loss_at_s) {
			LOG_INF("TEST: simulating link loss");
			k_event_clear(network_events(), NETWORK_EVT_UP);
			net_mgmt_event_notify(NET_EVENT_L4_DISCONNECTED, net_if_get_default());
			k_sleep(K_SECONDS(2));
			k_event_post(network_events(), NETWORK_EVT_UP);
		}
	}

	app_mqtt_get_stats(&st);
	mbedtls_memory_buffer_alloc_max_get(&heap_max, &blocks);
	struct uplink_stats us;

	uplink_get_stats(&us);
	LOG_INF("TEST RESULT state=%s connects=%u failures=%u tx=%u tx_bytes=%u dropped=%u "
		"rx=%u connect_ms=%u suite=0x%04x mbedtls_heap_peak=%u uplinks=%u",
		app_mqtt_state_str(app_mqtt_get_state()), st.connects, st.connect_failures,
		st.tx_msgs, st.tx_payload_bytes, st.tx_dropped, st.rx_msgs, st.last_connect_ms,
		st.last_ciphersuite, (unsigned int)heap_max, us.uplinks);
	exit(0);
	return 0;
}
```

## src/stubs.c
```c
/*
 * Zephyr_A - test stubs for modules that need the real hardware
 * (device_info: eFuse MAC + hwinfo; network: cellular modem + PPP;
 * sensor: coretemp/Modbus).
 *
 * network_request_up/down emulate the network thread for the interval
 * uplink (part 9): up -> NETWORK_EVT_UP after 200 ms ("modem start"),
 * down -> NET_EVENT_L4_DISCONNECTED + NETWORK_EVT_DOWN + state OFF.
 *
 * SPDX-License-Identifier: Apache-2.0
 */

#include <errno.h>

#include <zephyr/drivers/hwinfo.h>
#include <zephyr/kernel.h>
#include <zephyr/logging/log.h>
#include <zephyr/net/net_event.h>
#include <zephyr/net/net_if.h>
#include <zephyr/net/net_mgmt.h>
#include <zephyr/sys/atomic.h>

#include "app_types.h"
#include "device_info.h"
#include "network.h"
#include "sensor.h"

LOG_MODULE_REGISTER(test_stubs, LOG_LEVEL_INF);

K_EVENT_DEFINE(test_net_events);

const char *device_info_id(void)
{
	return "esp32c6-test0001";
}

const char *device_info_fw_version(void)
{
	return "0.9.0-test";
}

uint32_t device_info_reset_cause(void)
{
	return RESET_POR;
}

bool network_wait_up(k_timeout_t timeout)
{
	return k_event_wait(&test_net_events, NETWORK_EVT_UP, false, timeout) != 0U;
}

struct k_event *network_events(void)
{
	return &test_net_events;
}

int network_get_rssi(int16_t *rssi_dbm)
{
	*rssi_dbm = -71;
	return 0;
}

void app_sensor_trigger(void)
{
	LOG_INF("TEST: sensor trigger (config changed)");
}

const char *app_sensor_channel_name(uint8_t channel)
{
	return (channel == APP_CHANNEL_DIE_TEMP) ? "Temperature/Die" : "?";
}

const char *app_sensor_channel_unit(uint8_t channel)
{
	return (channel == APP_CHANNEL_DIE_TEMP) ? "degC" : "";
}

static atomic_t test_net_state = ATOMIC_INIT(NETWORK_STATE_OFF);

static void net_up_handler(struct k_work *work)
{
	ARG_UNUSED(work);
	atomic_set(&test_net_state, NETWORK_STATE_CONNECTED);
	k_event_clear(&test_net_events, NETWORK_EVT_DOWN);
	k_event_post(&test_net_events, NETWORK_EVT_UP);
	LOG_INF("TEST: network up");
}

static K_WORK_DELAYABLE_DEFINE(net_up_work, net_up_handler);

int network_request_up(void)
{
	if (atomic_get(&test_net_state) == NETWORK_STATE_OFF) {
		atomic_set(&test_net_state, NETWORK_STATE_STARTING);
		(void)k_work_schedule(&net_up_work, K_MSEC(200));
	}
	return 0;
}

int network_request_down(void)
{
	(void)k_work_cancel_delayable(&net_up_work);
	if (atomic_get(&test_net_state) != NETWORK_STATE_OFF) {
		k_event_clear(&test_net_events, NETWORK_EVT_UP);
		net_mgmt_event_notify(NET_EVENT_L4_DISCONNECTED, net_if_get_default());
		k_event_post(&test_net_events, NETWORK_EVT_DOWN);
		atomic_set(&test_net_state, NETWORK_STATE_OFF);
		LOG_INF("TEST: network down (modem off)");
	}
	return 0;
}

enum network_state network_get_state(void)
{
	return (enum network_state)atomic_get(&test_net_state);
}
```
