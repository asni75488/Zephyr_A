## app/tests/health/testcase.yaml
```yaml
tests:
  zephyr_a.health:
    platform_allow:
      - native_sim/native/64
    integration_platforms:
      - native_sim/native/64
    tags:
      - iiot
```
